## zephyr/Kconfig
```kconfig
menuconfig ZMK_ROBA_CLICK_GUARD
    bool "roBa mouse-click trackball guard"
    default y
    depends on ZMK_POINTING
    help
      Suppresses PMW3610 X/Y movement for a short period after a mouse
      button macro starts. The keymap activates the guard layer.

endmenu
```

## zephyr/dts/bindings/zmk,input-processor-roba-click-guard.yaml
```yaml
description: Suppress relative X/Y movement while the processor is active.

compatible: "zmk,input-processor-roba-click-guard"

include: base.yaml

properties:
  "#input-processor-cells":
    type: int
    const: 0
    description: No parameters.

track-remainders:
    type: boolean
    description: Whether the processor tracks input remainders.
```
